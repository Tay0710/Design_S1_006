#include <Arduino.h>
#include <TFT_eSPI.h>
#include <Wire.h>
#include <Bitcraze_PMW3901.h>

// Defining SPI pins
#define SPI_CS 10
#define SPI_MOSI 11
#define SPI_CLK 12
#define SPI_MISO 13
#define RST 3

TFT_eSPI tft = TFT_eSPI(170, 320); // Init screen size

// Using digital pin 10 for chip select
SPIClass SPI2(HSPI);
Bitcraze_PMW3901 flow(SPI_CS);

char frame[35*35]; //array to hold the framebuffer

int PixelScale = 4;


const PROGMEM uint16_t ironhot[] =  
{0x0000,0x0000,0x0000,0x0000,0x0000,0x0020,0x0020,
0x0020,0x0020,0x0020,0x0841,0x0841,0x0841,0x0841,
0x0841,0x0841,0x0861,0x0861,0x0861,0x0861,0x0861,
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0xdefb,0xdefb,0xe71c};

void setup() {
  SPI2.begin(SPI_CLK, SPI_MISO, SPI_MOSI, SPI_CS);
  Serial.begin(115200);

  tft.init();
  tft.setRotation(1);
  tft.setTextSize(2);
  tft.setTextDatum(MC_DATUM);
  tft.fillScreen(TFT_RED);
  tft.setTextColor(TFT_WHITE);

  if (!flow.begin()) {
    tft.print("Initialization of the flow sensor failed");
    while(1) { }
  }
  else {
    tft.print("Initialization of the flow sensor suceeded");
  }

  delay(2000);
  tft.fillScreen(TFT_BLACK);

  flow.enableFrameBuffer(); 
}

int16_t deltaX = 0;
int16_t deltaY = 0;

void loop() {
  flow.readFrameBuffer(frame);
  int i,j,k;
  for(i=0, k=0; i<35; i++){ //i is Y pixel pos
    for(j=0; j<35; j++, k++){  //j is X pixel pos
      uint8_t colorIndex = frame[k];
      //draw the pixels!
      tft.fillRect(4+PixelScale * i, 4+PixelScale * j, PixelScale, PixelScale, ironhot[colorIndex]); //Scale up function to fill screen
      }
  }

  tft.setCursor(150, 0);
  tft.setTextColor(TFT_BLACK);
  tft.print("X: ");
  tft.println(deltaX);

  tft.setCursor(150, 20);
  tft.print("Y: ");
  tft.print(deltaY);

  // Get motion count since last call
  flow.readMotionCount(&deltaX, &deltaY);

  tft.setCursor(150, 0);
  tft.setTextColor(TFT_WHITE);
  tft.print("X: ");
  tft.println(deltaX);

  tft.setCursor(150, 20);
  tft.print("Y: ");
  tft.print(deltaY);  
}